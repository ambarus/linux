## drivers/thermal/samsung/Kconfig
```kconfig
# SPDX-License-Identifier: GPL-2.0-only
config EXYNOS_THERMAL
	tristate "Exynos thermal management unit driver"
	depends on THERMAL_OF
	depends on HAS_IOMEM
	help
	  If you say yes here you get support for the TMU (Thermal Management
	  Unit) driver for Samsung Exynos series of SoCs. This driver initialises
	  the TMU, reports temperature and handles cooling action if defined.
	  This driver uses the Exynos core thermal APIs and TMU configuration
	  data from the supported SoCs.

config EXYNOS_ACPM_THERMAL
	tristate "Exynos ACPM thermal management unit driver"
	depends on THERMAL_OF
	depends on EXYNOS_ACPM_PROTOCOL || (COMPILE_TEST && !EXYNOS_ACPM_PROTOCOL)
	help
	  If you say yes here blurb
```
